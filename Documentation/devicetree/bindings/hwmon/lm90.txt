## Documentation/devicetree/bindings/hwmon/lm90.txt
```
* LM90 series thermometer.

Required node properties:
- compatible: manufacturer and chip name, one of
		"adi,adm1032"
		"adi,adt7461"
		"adi,adt7461a"
		"gmt,g781"
		"national,lm90"
		"national,lm86"
		"national,lm89"
		"national,lm99"
		"dallas,max6646"
		"dallas,max6647"
		"dallas,max6649"
		"dallas,max6657"
		"dallas,max6658"
		"dallas,max6659"
		"dallas,max6680"
		"dallas,max6681"
		"dallas,max6695"
		"dallas,max6696"
		"onnn,nct1008"
		"winbond,w83l771"
		"nxp,sa56004"

- reg: I2C bus address of the device

- vcc-supply: vcc regulator for the supply voltage.

- #thermal-sensor-cells: Should be 1. See ../../thermal/thermal.txt for a
                         description of this property. Use the following
                         values to refer to a specific sensor:
                         0: chip internal sensor
                         1: external sensor
                         2: second external sensor, if present

Optional properties:
- interrupts: Contains a single interrupt specifier which describes the
              LM90 "-ALERT" pin output.
              See interrupt-controller/interrupts.txt for the format.

- update-interval: Interval at which temperatures are sampled,
  Type: unsigned   in milliseconds.
  Size: one cell

- local-low:      Valid temperature range for the chip internal sensor,
  local-high:     outside which the alert will be set. Values are in
  local-critical: millicelcius.
  Type: signed
  Size: one cell

- remote-low:      Valid temperature range for the external sensor,
  remote-high:     outside which the alert will be set. Values are in
  remote-critical: millicelciius.
  Type: signed
  Size: one cell

- remote-offset:   Where available, an external sensor temperature offset.
  Type: signed
  Size: one cell

- local-emergency:  On max6659, max6695 and max6696, a configurable
  remote-emergency: 3rd upper bound on temperature.
  Type: signed
  Size: one cell

- remote2-low:      On max6695 and max6696, a second external sensor.
  remote2-high:
  remote2-critical:
  remote2-emergency:
  Type: signed
  Size: one cell

Example LM90 node:

temp-sensor {
	compatible = "onnn,nct1008";
	reg = <0x4c>;
	vcc-supply = <&palmas_ldo6_reg>;
	interrupt-parent = <&gpio>;
	interrupts = <TEGRA_GPIO(O, 4) IRQ_TYPE_LEVEL_LOW>;
	update-interval = <500>;
	local-low = <5000>;
	local-high = <80000>;
	local-critical = <90000>;
	remote-low = <5000>;
	remote-high = <80000>;
	remote-critical = <90000>;
	remote-offset = <(-62125)>;
	#thermal-sensor-cells = <1>;
}
```
